## drivers/misc/rk29_modem/Kconfig
```kconfig
#
# USB Serial device configuration
#

menuconfig RK29_SUPPORT_MODEM
	tristate "RK29 support Modem"
#	depends on USB11_HOST_EN
	---help---
	  Say Y here if you have a support modem

choice
	depends on RK29_SUPPORT_MODEM
	prompt  "Select 3G Modem"

    config MODEM_ROCKCHIP_DEMO
  	bool "ROCKCHIP_GENERAL_MODEM_DEVICE"

endchoice
```
